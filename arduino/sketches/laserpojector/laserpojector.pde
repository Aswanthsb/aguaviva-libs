#include <avr/pgmspace.h>

static uint8_t konami_font[] PROGMEM = {
  0x00, 0x00, 0x00, 0x00, 0x00, 0x00, 0x00, 0x00, 
  0x00, 0x00, 0x00, 0xBE, 0xBE, 0x0E, 0x00, 0x00, 
  0x00, 0x00, 0x0E, 0x06, 0x00, 0x0E, 0x06, 0x00, 
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  0x00, 0x00, 0x00, 0x00, 0x00, 0x00, 0x00, 0x00, 
};


static char sin_lut[] PROGMEM = {
  0x00,0x03,0x06,0x09,0x0c,0x0f,0x12,0x15,0x19,0x1c,0x1f,0x22,0x25,0x28,0x2b,0x2e,
  0x31,0x34,0x36,0x39,0x3c,0x3f,0x42,0x44,0x47,0x49,0x4c,0x4f,0x51,0x53,0x56,0x58,
  0x5a,0x5c,0x5f,0x61,0x63,0x65,0x67,0x68,0x6a,0x6c,0x6e,0x6f,0x71,0x72,0x73,0x75,
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  0xd2,0xd5,0xd8,0xdb,0xde,0xe1,0xe4,0xe7,0xeb,0xee,0xf1,0xf4,0xf7,0xfa,0xfd 
};

//-----------------------------------------------
const byte laserPin = 13;
const byte laserPin2 = 12;
const byte tacoPin = 2;

int line = 0;
char Video[] = " HELLO!!!  .... I AM A LASER PROJECTOR BUILT BY RAUL AGUAVIVA MORE INFO COODINGLAB.BLOGSPOT.COM ";

char VideoRam[10];

char *pVideo = Video;

const byte mask[8] = { 
  2,4,8,16,32,64,128};

int beamdelay[8] = { 
  0,0,0,0,0,0,0 };
  
boolean scroll;
unsigned int clockwall;
boolean wave;
boolean FullLaser;
boolean verbose;

volatile unsigned int rpmcount;
unsigned int rpm;

volatile unsigned long markers[7];
volatile boolean ignore = false;
volatile unsigned int start = 0;

void Reset()
{
  scroll = false;
  clockwall = 0;
  start = 0;
  wave = false;
  FullLaser = false;
  verbose = false;
  pVideo = Video;
}

void setup()
{
  Serial.begin(115200);

  pinMode(laserPin, OUTPUT);   // sets the pin as output
  pinMode(laserPin2, OUTPUT);   // sets the pin as output

  pinMode(tacoPin, INPUT);   // sets the pin as output
  digitalWrite( tacoPin, HIGH );     

  rpmcount = 0;
  rpm = 0;

  Serial.println( "Laser Projector Ready!" );      

  Reset();
  
  attachInterrupt(0, rpm_fun, FALLING);
  
}

void RasterLine( byte _line, unsigned int offset )
{
        digitalWrite( laserPin, HIGH );
        return;

  int t = beamdelay[_line];

  if ( wave )
  {
    t += (char)pgm_read_byte( &sin_lut[ (clockwall*16 + _line*16) & 0xff ] )/2;
  }

  for(int i=0;i<t;i++)
  {
    digitalWrite( laserPin, LOW );
    digitalWrite( laserPin2, LOW );
  }

  byte mascara = mask[_line];

  for(byte i=0;i<10;i++)
  {
    for(byte j=0;j<8;j++)
    {
      boolean m = ( pgm_read_byte( &konami_font[ (pVideo[offset>>3]-' ') * 8 + (offset&7)] ) & mascara )?HIGH:LOW;

      if ( FullLaser )
        m = HIGH;

      for(byte k=0;k<1;k++)
      {
        digitalWrite( laserPin, m );
//        digitalWrite( laserPin2, m );
      }
      offset++;
    }       
  }

  digitalWrite( laserPin, LOW );     
  digitalWrite( laserPin2, LOW );     
}


// 8224,7976,8292,7784,8228,8028,7876,
// <    >    <    >    <    >    >
void rpm_fun()
{
    rpmcount++; 
    if (ignore == true)
    {
      return;
    }
    ignore = true;

    static unsigned int olddelta = 0;
    static unsigned int oldtime = 0;
    static byte index = 0;
        
    unsigned long t = micros();
    unsigned int delta = t - oldtime;
    oldtime = t;

   // find pattern that signals first scanline
    static byte cond = 0;
    if ( olddelta > delta )
    {
      cond++;
      if ( cond == 2 )
      {
        index = 3;
        cond = 0;
      }
    }
    else
    {
      cond = 0;
    }

    markers[index] = delta;

    olddelta = delta;

    RasterLine( index, start );

    index++;
    if ( index >6 ) 
    {
      index = 0;

      clockwall++;

      if ( scroll )
      {
        start++;
        if ( start >55*8 )
          start = 0;
      }
    }    
    
    ignore = false;    
}


byte cmd=0;

void DoKeyboard()
{
  if (Serial.available() > 0) 
  {
    ignore = true;
    
    unsigned char in = Serial.read();

    if ( in == 'w' )
    {
      wave = !wave;
    }
    else if ( in == 'v' )
    {
      pVideo = VideoRam;
    }    
    else if ( in == 'V' )
    {
      pVideo = Video;
    }    
    else if ( in >= '0' && in <='9')
    {
      line = in-'0';
      Serial.println( line, DEC );    
    }
    else if ( in == '+' )
    {
      cmd++;      
      if ( line == 8 )
      {
        for(byte i=1;i<7;i++)
        {
          beamdelay[i]++;
        }
      }
      else
      {       
        beamdelay[line]++;
      }
      Serial.println( beamdelay[line], DEC );    
    }
    else if ( in == '-' )
    {
      cmd--;
      if ( line == 8 )
      {
        for(byte i=1;i<7;i++)
        {
          beamdelay[i]--;
        }
      }
      else
      {       
        beamdelay[line]--;
      }
      Serial.println( beamdelay[line], DEC );    
    }
    else if ( in == 'r' )
    {
      Reset();
    }
    else if ( in == 'f' )
    {
      FullLaser = !FullLaser;
    }
    else if ( in == 's' )
    {
      scroll = !scroll;
    }
    else if ( in == ' ' )
    {
      for(byte i=0;i<7;i++)
      {
        Serial.print( beamdelay[i], DEC );    
        Serial.print(',');         
      }
      Serial.println();

      for(byte i=0;i<7;i++)
      {
        Serial.print( markers[i], DEC );    
        Serial.print(',');         
      }
      Serial.println();
    }
    else if ( in == 'q' )
    {
      rpmcount = 0;
      delay (1000);
      Serial.print ((rpmcount *60) / 7, DEC);
      Serial.println (" rpm");
    }

  ignore = false;
  }  
}

// |________|________|________|________|________|________|________|__|_____
// 0        1        2        3        4        5        6        7

//0:10100 ,1:9676 ,2:10116 ,3:9744 ,4:9840 ,5:10056 ,6:9868 
// <       >        <        >       <       <        >



unsigned long lastlap;
unsigned int t1;
boolean lastcmp = true;

byte scanline = 0;



void loop()
{
  DoKeyboard();  
}





//----------------------------------------------- 



